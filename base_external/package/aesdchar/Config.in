## base_external/package/aesdchar/Config.in
```kconfig
config BR2_PACKAGE_AESDCHAR
    bool "aesdchar"
    help
      Builds and installs the AESD char driver from GitHub
```

## base_external/package/ldd/Config.in
```kconfig
config BR2_PACKAGE_LDD
	bool "ldd"
	help
	  Build and install kernel modules from the ldd3 repository,
	  including misc-modules (hello, faulty) and scull.
```
